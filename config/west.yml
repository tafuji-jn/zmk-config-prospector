## config/west.yml
```yaml
manifest:
  remotes:
    - name: zmkfirmware
      url-base: https://github.com/zmkfirmware
    - name: prospector
      url-base: https://github.com/tafuji-jn
  projects:
    - name: zmk
      remote: zmkfirmware
      revision: 354cff9c36b49eee6abbb8a61e6b927539aebbf2
      import: app/west.yml
    - name: prospector-zmk-module
      remote: prospector
      revision: main
      path: modules/prospector-zmk-module
  self:
    path: config
```
